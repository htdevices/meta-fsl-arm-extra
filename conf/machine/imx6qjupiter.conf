## conf/machine/imx6qjupiter.conf
```bitbake
#@TYPE: Machine
#@NAME: HTD-iMX6Q-Jupiter
#@SOC: i.MX6 Q/DL
#@DESCRIPTION: Machine configuration for HTD iMX6Q Jupiter board
#@MAINTAINER: Adrian Alonso <aalonso@htdevices.com>

# Machine config for HTD iMX6Q Jupiter board.

require conf/machine/include/imx-base.inc
require conf/machine/include/tune-cortexa9.inc

SOC_FAMILY = "mx6:mx6q"

PREFERRED_PROVIDER_u-boot = "u-boot-htd"
PREFERRED_PROVIDER_virtual/kernel = "linux-htd"
PREFERRED_VERSION_linux-htd = "3.0.35"

UBOOT_PADDING = "2"
UBOOT_SUFFIX = "bin"
UBOOT_MACHINE = "mx6q_jupiter_config"
UBOOT_MAKE_TARGET = "u-boot.bin"

MACHINE_FEATURES += "wifi bluetooth alsa serial usbhost"
MACHINE_FIRMWARE_append_mx6 = " linux-firmware-ath6k"

SERIAL_CONSOLE = "115200 ttymxc1"
```
